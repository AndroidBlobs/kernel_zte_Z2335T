/* Copyright (c) 2013, The Linux Foundation. All rights reserved.
 *
 * This program is free software; you can redistribute it and/or modify
 * it under the terms of the GNU General Public License version 2 and
 * only version 2 as published by the Free Software Foundation.
 *
 * This program is distributed in the hope that it will be useful,
 * but WITHOUT ANY WARRANTY; without even the implied warranty of
 * MERCHANTABILITY or FITNESS FOR A PARTICULAR PURPOSE.  See the
 * GNU General Public License for more details.
 */

/*---------------------------------------------------------------------------
 * This file is autogenerated file using gcdb parser. Please do not edit it.
 * Update input XML file to add a new entry or update variable in this file
 * VERSION = "1.0"
 *---------------------------------------------------------------------------*/
&mdss_mdp {
	dsi_truly_truly_st7701s_480p_video: qcom,mdss_dsi_truly_truly_st7701s_480p_video {
		qcom,mdss-dsi-panel-name = "truly truly st7701s 480p video mode dsi panel";
		zte,lcd-init-code-version = "20180718";
		qcom,cont-splash-enabled;
		qcom,panel-supply-entries = <&dsi_panel_pwr_supply>;
		qcom,mdss-dsi-panel-controller = <&mdss_dsi0>;
		qcom,mdss-dsi-panel-type = "dsi_video_mode";
		qcom,mdss-dsi-panel-destination = "display_1";
		qcom,mdss-dsi-panel-framerate = <60>;
		qcom,mdss-dsi-virtual-channel-id = <0>;
		qcom,mdss-dsi-stream = <0>;
		qcom,mdss-pan-physical-height-dimension = <121>;
		qcom,mdss-pan-physical-width-dimension = <61>;
		qcom,mdss-dsi-panel-width = <480>;
		qcom,mdss-dsi-panel-height = <960>;
		qcom,mdss-dsi-h-front-porch = <60>;
		qcom,mdss-dsi-h-back-porch = <40>;
		qcom,mdss-dsi-h-pulse-width = <12>;
		qcom,mdss-dsi-h-sync-skew = <0>;
		qcom,mdss-dsi-v-back-porch = <12>;
		qcom,mdss-dsi-v-front-porch = <16>;
		qcom,mdss-dsi-v-pulse-width = <4>;
		qcom,mdss-dsi-h-left-border = <0>;
		qcom,mdss-dsi-h-right-border = <0>;
		qcom,mdss-dsi-v-top-border = <0>;
		qcom,mdss-dsi-v-bottom-border = <0>;
		qcom,mdss-dsi-bpp = <24>;
		qcom,mdss-dsi-color-order = "rgb_swap_rgb";
		qcom,mdss-dsi-underflow-color = <0xff>;
		qcom,mdss-dsi-border-color = <0>;
		qcom,mdss-dsi-on-command = [05 01 00 00 78 00 02 11 00
			29 01 00 00 00 00 06 FF 77 01 00 00 10
			29 01 00 00 00 00 03 C0 F7 01
			29 01 00 00 00 00 03 C1 0A 02
			29 01 00 00 00 00 03 C2 07 02
			29 01 00 00 00 00 02 CC 10
			15 01 00 00 00 00 02 BB 00
			15 01 00 00 00 00 02 CA 11
			15 01 00 00 00 00 02 BC 01
			29 01 00 00 00 00 06 FF 77 01 00 00 11
			29 01 00 00 00 00 02 B0 4D
			29 01 00 00 00 00 02 B2 87
			29 01 00 00 00 00 02 B3 80
			29 01 00 00 00 00 02 B5 47
			29 01 00 00 00 00 02 B7 89
			29 01 00 00 00 00 02 B8 21
			29 01 00 00 00 00 02 B9 10
			29 01 00 00 00 00 02 C1 78
			29 01 00 00 00 00 02 C2 78
			29 01 00 00 00 00 02 D0 88
			29 01 00 00 00 00 04 E0 00 00 02
			29 01 00 00 00 00 0C E1 06 78 04 78 07 78 05 78 00 22 22
			29 01 00 00 00 00 0E E2 33 33 22 22 C8 78 CA 78 C9 78 CB 78 00
			29 01 00 00 00 00 05 E3 00 00 33 33
			29 01 00 00 00 00 03 E4 44 44
			29 01 00 00 00 00 11 E5 06 CA 88 78 08 CA 88 78 0A CA 88 78 0C CA 88 78
			29 01 00 00 00 00 05 E6 00 00 33 33
			29 01 00 00 00 00 03 E7 44 44
			29 01 00 00 00 00 11 E8 07 CA 88 78 09 CA 88 78 0B CA 88 78 0D CA 88 78
			29 01 00 00 00 00 08 EB 00 02 E4 E4 BB 33 00
			29 01 00 00 00 00 03 EC 00 00
			29 01 00 00 00 00 11 ED 72 36 54 FF 10 FF FF FF FF FF FF 01 FF 45 63 27
			29 01 00 00 00 00 06 FF 77 01 00 00 00

			29 01 00 00 00 00 02 51 00
			29 01 00 00 00 00 02 53 0c
			29 01 00 00 00 00 02 55 01
			05 01 00 00 78 00 02 29 00];
		qcom,mdss-dsi-off-command = [39 01 00 00 00 00 02 53 00
					05 01 00 00 32 00 02 28 00
					05 01 00 00 78 00 02 10 00];
		qcom,mdss-dsi-on-command-state = "dsi_lp_mode";
		qcom,mdss-dsi-off-command-state = "dsi_lp_mode";
		qcom,mdss-dsi-h-sync-pulse = <1>;
		qcom,mdss-dsi-traffic-mode = "burst_mode";
		qcom,mdss-dsi-lane-map = "lane_map_0123";
		qcom,mdss-dsi-bllp-eof-power-mode;
		qcom,mdss-dsi-bllp-power-mode;
		qcom,mdss-dsi-lane-0-state;
		qcom,mdss-dsi-lane-1-state;
		qcom,mdss-dsi-panel-timings = [79 1A 12 00 3E 42 16 1E 15 03 04 00];
		qcom,mdss-dsi-t-clk-post = <0x04>;
		qcom,mdss-dsi-t-clk-pre = <0x1A>;
		qcom,mdss-dsi-bl-min-level = <4>;
		qcom,mdss-dsi-bl-max-level = <255>;
		qcom,mdss-dsi-dma-trigger = "trigger_sw";
		qcom,mdss-dsi-mdp-trigger = "none";
		qcom,mdss-dsi-bl-pmic-control-type = "bl_ctrl_dcs";
		qcom,mdss-dsi-reset-sequence = <1 20>, <0 2>, <1 20>;
		qcom,mdss-dsi-lp11-init;
		zte,mdss-dsi-cabc-53h-value = <0x0c>;
                qcom,esd-check-enabled;
                qcom,mdss-dsi-panel-status-command=[06 01 00 01 05 00 01 0a
                                                06 01 00 01 05 00 01 0b];
                qcom,mdss-dsi-panel-status-command-state="dsi_lp_mode";
                qcom,mdss-dsi-panel-status-check-mode="reg_read";
                qcom,mdss-dsi-panel-status-value=<0x9C 0x00>;
                qcom,mdss-dsi-panel-status-read-length = <1 1>;
                qcom,mdss-dsi-panel-status-valid-params = <1 1>;
                qcom,mdss-dsi-panel-max-error-count = <3>;
	};
};
