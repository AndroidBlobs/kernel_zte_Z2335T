## drivers/input/touchscreen/chipone-ts/Kconfig
```kconfig
#
# Chipone Touchscreen driver configuration
#

config TOUCHSCREEN_CHIPONE
	bool "Chipone Touchscreen"
		depends on I2C
		default n
		help
		  Say Y here if you have Chipone touch panel.
		  If unsure, say N.
```
